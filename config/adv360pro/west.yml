## config/adv360pro/west.yml
```yaml
manifest:
  remotes:
    - name: zmkfirmware
      url-base: https://github.com/zmkfirmware
  projects:
    - name: zmk
      remote: zmkfirmware
      revision: main
      import: app/west.yml
  self:
    path: config

# Local Variables:
# jinx-local-words: "yml zmk zmkfirmware"
# End:
```
